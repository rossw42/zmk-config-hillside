## boards/shields/cradio36/Kconfig.defconfig
```kconfig
# Copyright (c) 2021 The ZMK Contributors
# SPDX-License-Identifier: MIT

if SHIELD_CRADIO36_LEFT

config ZMK_KEYBOARD_NAME
    default "CRADIO36"

config ZMK_SPLIT_BLE_ROLE_CENTRAL
    default y

endif

if SHIELD_CRADIO36_LEFT || SHIELD_CRADIO36_RIGHT

config ZMK_SPLIT
    default y

endif
```

## boards/shields/generic_3x5/Kconfig.defconfig
```kconfig
# Copyright (c) 2024 The ZMK Contributors
# SPDX-License-Identifier: MIT

if SHIELD_GENERIC_3X5_LEFT

config ZMK_KEYBOARD_NAME
    default "Generic 3x5"

config ZMK_SPLIT_ROLE_CENTRAL
    default y

endif

if SHIELD_GENERIC_3X5_LEFT || SHIELD_GENERIC_3X5_RIGHT

config ZMK_SPLIT
    default y

endif
```

## boards/shields/generic_3x5/Kconfig.shield
```kconfig
# Copyright (c) 2024 The ZMK Contributors
# SPDX-License-Identifier: MIT

config SHIELD_GENERIC_3X5_LEFT
    def_bool $(shields_list_contains,generic_3x5_left)

config SHIELD_GENERIC_3X5_RIGHT
    def_bool $(shields_list_contains,generic_3x5_right)
```

## boards/shields/generic_3x6/Kconfig.defconfig
```kconfig
# Copyright (c) 2024 The ZMK Contributors
# SPDX-License-Identifier: MIT

if SHIELD_GENERIC_3X6_LEFT

config ZMK_KEYBOARD_NAME
    default "Generic 3x6"

config ZMK_SPLIT_ROLE_CENTRAL
    default y

endif

if SHIELD_GENERIC_3X6_LEFT || SHIELD_GENERIC_3X6_RIGHT

config ZMK_SPLIT
    default y

endif
```

## boards/shields/generic_3x6/Kconfig.shield
```kconfig
# Copyright (c) 2024 The ZMK Contributors
# SPDX-License-Identifier: MIT

config SHIELD_GENERIC_3X6_LEFT
    def_bool $(shields_list_contains,generic_3x6_left)

config SHIELD_GENERIC_3X6_RIGHT
    def_bool $(shields_list_contains,generic_3x6_right)
```

## boards/shields/hypergarlic/Kconfig.defconfig
```kconfig
config ZMK_SPLIT
    default y

if SHIELD_HYPERGARLIC_LEFT
	config ZMK_SPLIT_ROLE_CENTRAL
		default y
	config ZMK_KEYBOARD_NAME
		default "Hyper Garlic"

endif


if SHIELD_HYPERGARLIC_RIGHT

	config ZMK_KEYBOARD_NAME
		default "HYPERGARLIC_right"

	endif

config ZMK_KSCAN_DIRECT_POLLING
	default n
```

## boards/shields/om/kconfig.config
```kconfig
# Copyright (c) 2021 The ZMK Contributors
# SPDX-License-Identifier: MIT

if SHIELD_OM_LEFT

# Name must be less than 16 characters long!
config ZMK_KEYBOARD_NAME
    default "Om"

config ZMK_SPLIT_ROLE_CENTRAL
    default y

endif

if SHIELD_OM_LEFT || SHIELD_OM_RIGHT

config ZMK_SPLIT
    default y

endif
```

## boards/shields/om/kconfig.shield
```kconfig
# No whitespace after the cOMma or in your part name!
config SHIELD_OM_LEFT
    def_bool $(shields_list_contains,OM_left)

# No whitespace after the cOMma or in your part name!
config SHIELD_OM_RIGHT
    def_bool $(shields_list_contains,OM_right)
```

## config/boards/shields/om/kconfig.config
```kconfig
# Copyright (c) 2021 The ZMK Contributors
# SPDX-License-Identifier: MIT

if SHIELD_A_DUX_LEFT

# Name must be less than 16 characters long!
config ZMK_KEYBOARD_NAME
    default "Om"

config ZMK_SPLIT_ROLE_CENTRAL
    default y

endif

if SHIELD_A_DUX_LEFT || SHIELD_A_DUX_RIGHT

config ZMK_SPLIT
    default y

endif
```

## config/boards/shields/om/kconfig.shield
```kconfig
# No whitespace after the cA_DUXma or in your part name!
config SHIELD_A_DUX_LEFT
    def_bool $(shields_list_contains,A_DUX_left)

# No whitespace after the cA_DUXma or in your part name!
config SHIELD_A_DUX_RIGHT
    def_bool $(shields_list_contains,A_DUX_right)
```

## config/west.yml
```yaml
manifest:
  remotes:
    - name: zmk-config-hillside
      url-base: https://github.com/rossw42/
  projects:
    - name: zmk-config-hillside
      remote: zmk-config-hillside
      revision: main
      import: west.yml
  self:
    path: config
```
